## conf/machine/luckfox-lyra.conf
```bitbake
#@TYPE: Machine
#@NAME: luckfox-lyra
#@DESCRIPTION: Configuration for luckfox-lyra based on

include conf/machine/rockchip-rk3506-evb.conf

DEFAULTTUNE = "cortexa7thf-neon-vfpv4"
MACHINEOVERRIDES .= ":rockchip-rk3506-evb"

WKS_FILE ?= "luckfox-lyra.wks.in"
IMAGE_FSTYPES += "wic wic.gz wic.bmap"

KERNEL_DEVICETREE = "rk3506g-luckfox-lyra.dtb"

EXTRA_IMAGEDEPENDS += "virtual/bootloader"
PREFERRED_PROVIDER_virtual/bootloader = "u-boot"
PREFERRED_VERSION_u-boot = "2026.07%"
UBOOT_MACHINE = "luckfox-lyra-rk3506_defconfig"

KERNEL_IMAGETYPE = "zImage"

UBOOT_EXTLINUX = "1"
UBOOT_EXTLINUX_ROOT = "root=/dev/mmcblk0p2 rw rootwait"
UBOOT_EXTLINUX_CONSOLE = "console=ttyFIQ0,1500000"

UBOOT_EXTLINUX_KERNEL_IMAGE = "../${KERNEL_IMAGETYPE}"
UBOOT_EXTLINUX_FDT = "../${KERNEL_DEVICETREE}"

IMAGE_BOOT_FILES = " \
    ${KERNEL_IMAGETYPE} \
    ${KERNEL_DEVICETREE} \
    extlinux.conf;extlinux/extlinux.conf \
"
```
